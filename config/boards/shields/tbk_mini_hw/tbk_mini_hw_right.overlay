#include "tbk_mini_hw.dtsi"

&default_transform {
    col-offset = <21>;
};

/ {
    kscan0: kscan {
        compatible = "zmk,kscan-gpio-direct";
        label = "KSCAN";
        input-gpios
            = <&gpio0 24 (GPIO_ACTIVE_LOW | GPIO_PULL_UP)> // 024
            , <&gpio0 22 (GPIO_ACTIVE_LOW | GPIO_PULL_UP)> // 022
            , <&gpio0 20 (GPIO_ACTIVE_LOW | GPIO_PULL_UP)> // 020
            , <&gpio0 17 (GPIO_ACTIVE_LOW | GPIO_PULL_UP)> // 017
            , <&gpio0  8 (GPIO_ACTIVE_LOW | GPIO_PULL_UP)> // 008
            , <&gpio0  6 (GPIO_ACTIVE_LOW | GPIO_PULL_UP)> // 006
            
            , <&gpio1  2 (GPIO_ACTIVE_LOW | GPIO_PULL_UP)> // 102
            , <&gpio1  1 (GPIO_ACTIVE_LOW | GPIO_PULL_UP)> // 101
            , <&gpio1  6 (GPIO_ACTIVE_LOW | GPIO_PULL_UP)> // 106
            , <&gpio1  4 (GPIO_ACTIVE_LOW | GPIO_PULL_UP)> // 104
            , <&gpio0 11 (GPIO_ACTIVE_LOW | GPIO_PULL_UP)> // 011
            , <&gpio1  0 (GPIO_ACTIVE_LOW | GPIO_PULL_UP)> // 100
            
            , <&gpio1 15 (GPIO_ACTIVE_LOW | GPIO_PULL_UP)> // 115
            , <&gpio1 13 (GPIO_ACTIVE_LOW | GPIO_PULL_UP)> // 113
            , <&gpio1 11 (GPIO_ACTIVE_LOW | GPIO_PULL_UP)> // 111
            , <&gpio0 10 (GPIO_ACTIVE_LOW | GPIO_PULL_UP)> // 010
            , <&gpio0  9 (GPIO_ACTIVE_LOW | GPIO_PULL_UP)> // 009
            , <&gpio1  7 (GPIO_ACTIVE_LOW | GPIO_PULL_UP)> // 107
            
            , <&gpio0 31 (GPIO_ACTIVE_LOW | GPIO_PULL_UP)> // 031
            , <&gpio0 29 (GPIO_ACTIVE_LOW | GPIO_PULL_UP)> // 029
            , <&gpio0  2 (GPIO_ACTIVE_LOW | GPIO_PULL_UP)> // 002
            ;
    };
};
