## config/boards/shields/tbk_mini_hw/Kconfig.defconfig
```kconfig
if SHIELD_TBK_MINI_HW_LEFT

# Name must be less than 16 characters long!
config ZMK_KEYBOARD_NAME
    default "TBK Mini"

config ZMK_SPLIT_ROLE_CENTRAL
    default y

endif

if SHIELD_TBK_MINI_HW_LEFT || SHIELD_TBK_MINI_HW_RIGHT

config ZMK_SPLIT
    default y

endif
```

## config/boards/shields/tbk_mini_hw/Kconfig.shield
```kconfig
config SHIELD_TBK_MINI_HW_LEFT
    def_bool $(shields_list_contains,tbk_mini_hw_left)

config SHIELD_TBK_MINI_HW_RIGHT
    def_bool $(shields_list_contains,tbk_mini_hw_right)
```
